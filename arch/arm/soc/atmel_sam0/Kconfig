## arch/arm/soc/atmel_sam0/Kconfig
```kconfig
# Kconfig - Atmel SAM0 MCU family configuration options
#
# Copyright (c) 2017 Google LLC.
# SPDX-License-Identifier: Apache-2.0

config SOC_FAMILY_SAM0
	bool
	default n

if SOC_FAMILY_SAM0

config SOC_FAMILY
	string
	default atmel_sam0

config SOC_ATMEL_SAMD_XOSC32K
	bool "Enable the external 32 kHz crystal oscillator"
	default n
	help
	  Say y to enable the external 32 kHZ crystal oscillator at
	  startup.  This can then be selected as the main clock source
	  for the SOC.

config SOC_ATMEL_SAMD_XOSC
	bool "Enable the external crystal oscillator"
	default n
	help
	  Say y to enable the external crystal oscillator at startup.

choice
	prompt "Main clock source"
	help
	  Selects the clock that the main clocks, such as the CPU
	  clock and AHB clock, will be derived from.

config SOC_ATMEL_SAMD_XOSC32K_AS_MAIN
	depends on SOC_ATMEL_SAMD_XOSC32K
	bool "XOSC32K"

config SOC_ATMEL_SAMD_XOSC_AS_MAIN
	depends on SOC_ATMEL_SAMD_XOSC
	bool "XOSC"

config SOC_ATMEL_SAMD_OSC8M_AS_MAIN
	bool "OSC8M"

endchoice

endif

source "arch/arm/soc/atmel_sam0/*/Kconfig.soc"
```

## arch/arm/soc/atmel_sam0/samd20/Kconfig.series
```kconfig
# Kconfig - Atmel SAMD MCU series
#
# Copyright (c) 2017 Google LLC.
# SPDX-License-Identifier: Apache-2.0

config SOC_SERIES_SAMD20
	bool "Atmel SAMD20 MCU"
	select CPU_CORTEX_M
	select CPU_CORTEX_M0PLUS
	select SOC_FAMILY_SAM0
	select SYS_POWER_LOW_POWER_STATE_SUPPORTED
	select CPU_HAS_SYSTICK
	select ASF
	help
	  Enable support for Atmel SAMD20 Cortex-M0+ microcontrollers.
```

## arch/arm/soc/atmel_sam0/samd20/Kconfig.soc
```kconfig
# Kconfig - Atmel SAMD MCU series
#
# Copyright (c) 2017 Google LLC.
# SPDX-License-Identifier: Apache-2.0

choice
prompt "Atmel SAMD20 MCU Selection"
depends on SOC_SERIES_SAMD20

config SOC_PART_NUMBER_SAMD20E15
	bool "SAMD20E15"

config SOC_PART_NUMBER_SAMD20E16
	bool "SAMD20E16"

config SOC_PART_NUMBER_SAMD20E17
	bool "SAMD20E17"

config SOC_PART_NUMBER_SAMD20E18
	bool "SAMD20E18"

config SOC_PART_NUMBER_SAMD20G15
	bool "SAMD20G15"

config SOC_PART_NUMBER_SAMD20G16
	bool "SAMD20G16"

config SOC_PART_NUMBER_SAMD20G17
	bool "SAMD20G17"

config SOC_PART_NUMBER_SAMD20G17U
	bool "SAMD20G17U"

config SOC_PART_NUMBER_SAMD20G18
	bool "SAMD20G18"

config SOC_PART_NUMBER_SAMD20G18U
	bool "SAMD20G18U"

config SOC_PART_NUMBER_SAMD20J15
	bool "SAMD20J15"

config SOC_PART_NUMBER_SAMD20J16
	bool "SAMD20J16"

config SOC_PART_NUMBER_SAMD20J17
	bool "SAMD20J17"

config SOC_PART_NUMBER_SAMD20J18
	bool "SAMD20J18"

endchoice

if SOC_SERIES_SAMD20

config SOC_ATMEL_SAMD_XOSC32K
	bool "Enable the external 32 kHz crystal oscillator"
	default n
	help
	  Say y to enable the external 32 kHZ crystal oscillator at
	  startup.  This can then be selected as the main clock source
	  for the SOC.

config SOC_ATMEL_SAMD_XOSC
	bool "Enable the external crystal oscillator"
	default n
	help
	  Say y to enable the external crystal oscillator at startup.

choice
	prompt "Main clock source"
	help
	  Selects the clock that the main clocks, such as the CPU
	  clock and AHB clock, will be derived from.

config SOC_ATMEL_SAMD_XOSC32K_AS_MAIN
	depends on SOC_ATMEL_SAMD_XOSC32K
	bool "XOSC32K"

config SOC_ATMEL_SAMD_XOSC_AS_MAIN
	depends on SOC_ATMEL_SAMD_XOSC
	bool "XOSC"

config SOC_ATMEL_SAMD_OSC8M_AS_MAIN
	bool "OSC8M"

endchoice

endif # SOC_SERIES_SAMD20
```
